// v1 - Led Array + HC-SR04 Sensor + DHT Sensor + PIR Sensor/Buzzer
#include <avr/pgmspace.h>
#include <TimerOne.h>
#include <Ultrasonic.h>
#include <dht.h>
   
//Led Array
int DataPin = 4; // DIN
int ClockPin = 5; // CLK
int LoadPin = 6; // CS/Load

//HC-SR04
Ultrasonic ultrasonic(8,7);
long distance;

//DHT
dht DHT;
uint32_t timer = 0;
long DHThumidity;
long DHTtemperature;

//PIR/Buzzer
int pir = 3;
int trigger;
const int buzzer = 13;
  
byte buffer[8];  
   
const static byte font[][8] PROGMEM = {  
{B00000000, B00000000, B00000000, B00000000, B00000000, B00000000, B00000000, B00000000},   
{B00000100, B00000100, B00000100, B00000100, B00000100, B00000100, B00000000, B00000100},   
{B00001010, B00001010, B00001010, B00000000, B00000000, B00000000, B00000000, B00000000},   
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{B00000000, B00000000, B00000000, B00001010, B00011110, B00010100, B00000000, B00000000}   
};  
   
void clearDisplay() 
{
    for (byte x=0; x<8; x++) 
    {  
       buffer[x] = B00000000;  
    }  
    screenUpdate();  
}  
  
void initMAX7219() 
{  
    pinMode(DataPin, OUTPUT);  
    pinMode(LoadPin, OUTPUT);  
    pinMode(ClockPin, OUTPUT);  
    clearDisplay();  
    writeData(B00001011, B00000111);   
    writeData(B00001001, B00000000);   
    writeData(B00001100, B00000001);   
    intensity(1);   
}  
   
void intensity(int intensity) 
{  
    writeData(B00001010, intensity);   
}  
   
void writeData(byte MSB, byte LSB) 
{  
    byte mask;  
    digitalWrite(LoadPin, LOW);   
      
    for (mask = B10000000; mask>0; mask >>= 1) 
    {   
        digitalWrite(ClockPin, LOW);  
        if (MSB & mask)
        {   
           digitalWrite(DataPin,HIGH);   
        }  
        else
        {   
           digitalWrite(DataPin,LOW);   
        }  
        digitalWrite(ClockPin, HIGH);   
    }  
      
    for (mask = B10000000; mask>0; mask >>= 1) 
    {   
        digitalWrite(ClockPin, LOW);  
        if (LSB & mask)
        {   
           digitalWrite(DataPin,HIGH);   
        }  
        else
        {   
            digitalWrite(DataPin,LOW);   
        }  
        digitalWrite(ClockPin, HIGH);   
    }  
    digitalWrite(LoadPin, HIGH);   
    digitalWrite(ClockPin, LOW);  
}  
   
void scroll(char myString[], int speed) 
{  
    byte firstChrRow, secondChrRow;  
    byte ledOutput;  
    byte chrPointer = 0;   
    byte Char1, Char2;   
    byte scrollBit = 0;  
    byte strLength = 0;  
    unsigned long time;  
    unsigned long counter;  
       
    while (myString[strLength]) {strLength++;}  
    counter = millis();  
    while (chrPointer < (strLength-1)) 
    {  
       time = millis();  
       if (time > (counter + speed)) 
       { 
          Char1 = myString[chrPointer];  
          Char2 = myString[chrPointer+1];  
          for (byte y= 0; y<8; y++) 
          {  
            firstChrRow = pgm_read_byte(&font[Char1 - 32][y]);  
            secondChrRow = (pgm_read_byte(&font[Char2 - 32][y])) << 1;  
            ledOutput = (firstChrRow << scrollBit) | (secondChrRow >> (8 - scrollBit) );  
            buffer[y] = ledOutput;  
          }  
            scrollBit++;   
            if (scrollBit > 6) 
            {   
              scrollBit = 0;  
              chrPointer++;  
            }  
            counter = millis();  
        }  
    }  
}  
   
void screenUpdate() 
{  
   for (byte row = 0; row < 8; row++) 
   { 
      writeData(row+1, buffer[row]);
   }
}  
   
void setup() 
{  
   initMAX7219(); 
   Serial.begin(9600); 
   Timer1.initialize(10000);       
   Timer1.attachInterrupt(screenUpdate);
   pinMode(pir, INPUT);
}  
  
void loop() 
{  
   //HC-SR04 Setup
   distance = float(ultrasonic.read(CM));
   String dist(distance);
   String distUnid = "DIS. ";
   char distText[20];
   distUnid.concat(dist);
   distUnid.toCharArray(distText,20);
   clearDisplay();    
   //Exibe a mensagem, com intervalo de scroll de 100
   scroll(distText, 100); 
   delay(2000);


   //DHT Setup
   DHT.read11(A1);
   
   DHThumidity = float(DHT.humidity);
   String humi(DHThumidity);
   String humiUnid = "HUM. "; 
   char humiText[20];
   humiUnid.concat(humi);
   humiUnid.toCharArray(humiText,20);
   clearDisplay();    
   //Exibe a mensagem, com intervalo de scroll de 100
   scroll(humiText, 100); 
   delay(2000);
   
   DHTtemperature = float(DHT.temperature);
   String temp(DHTtemperature);
   String tempUnid = "TEM. "; 
   char tempText[20];
   tempUnid.concat(temp);
   tempUnid.toCharArray(tempText,20);
   clearDisplay();    
   //Exibe a mensagem, com intervalo de scroll de 100
   scroll(tempText, 100); 
   delay(2000);

   
   //PIR Setup
   trigger = digitalRead(pir);
   if (trigger == HIGH) {
     tone (buzzer, 100, 100); 
     clearDisplay();    
     //Exibe a mensagem, com intervalo de scroll de 100
     scroll("PIR ACIONADO ", 100);
     delay(2000); 
   }
}
